## boards/shields/yads_bongo_cat/Kconfig.defconfig
```kconfig
# SPDX-License-Identifier: MIT

if SHIELD_YADS_BONGO_CAT

config YADS_BONGO_CAT_MIN_TAP_MS
    int "Minimum time a paw stays down per key press (ms)"
    default 80
    help
      Keeps quick taps visible even if press and release arrive within one display refresh.

config YADS_BONGO_CAT_IDLE_MS
    int "Time without key presses before the cat goes back to resting (ms)"
    default 1000

endif # SHIELD_YADS_BONGO_CAT
```

## boards/shields/yads_bongo_cat/Kconfig.shield
```kconfig
# SPDX-License-Identifier: MIT

config SHIELD_YADS_BONGO_CAT
    def_bool $(shields_list_contains,yads_bongo_cat)
```
